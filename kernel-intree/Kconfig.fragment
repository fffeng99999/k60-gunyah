## kernel-intree/Kconfig.fragment
```kconfig
# SPDX-License-Identifier: GPL-2.0-only
#
# K60 (mondrian, SM8475) in-tree Gunyah VM manager.
#
# This block is inserted into the "if GUNYAH_DRIVERS ... endif" body of
# drivers/virt/gunyah/Kconfig by apply_intree.sh.

config GH_VM_MGR
	tristate "Gunyah VM manager (/dev/gunyah)"
	depends on GH_RM_DRV
	select ANON_INODES
	select EVENTFD
	help
	  Creates /dev/gunyah and implements the VM create / configure /
	  start / stop ioctls a userspace virtual machine manager needs,
	  including vCPU, irqfd and ioeventfd functions.

	  Required by Android VMMs such as DroidVM and crosvm. The vendor
	  kernel ships the lower Gunyah drivers but not this layer, which
	  is why /dev/gunyah is absent by default.

	  Note this cannot be built in: it depends on GH_RM_DRV, which the
	  vendor config sets to =m, and turning that into =y would mean
	  dropping gh_rm_drv.ko, the module DRM, qrtr and the virtio
	  backends load. Say M.

	  If unsure, say M.
```
